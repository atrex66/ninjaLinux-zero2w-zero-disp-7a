## Config.in
```kconfig
source "$BR2_EXTERNAL_FASTLINUX_PATH/package/fastlinux-demo/Config.in"
source "$BR2_EXTERNAL_FASTLINUX_PATH/package/python-pyside6/Config.in"

source "$BR2_EXTERNAL_FASTLINUX_PATH/package/automation-hal/Config.in"

source "$BR2_EXTERNAL_FASTLINUX_PATH/package/ninjalinux-usb-autostart/Config.in"
```

## configs/fastlinux_rt_wifi_ap_defconfig
```kconfig
BR2_aarch64=y
BR2_ARM_FPU_VFPV4=y
BR2_TOOLCHAIN_EXTERNAL=y
BR2_TOOLCHAIN_EXTERNAL_BOOTLIN=y
BR2_TOOLCHAIN_EXTERNAL_BOOTLIN_AARCH64_GLIBC_STABLE=y
BR2_GLOBAL_PATCH_DIR="board/raspberrypi/patches $(BR2_EXTERNAL_FASTLINUX_PATH)/board/fastlinux/patches"
BR2_DOWNLOAD_FORCE_CHECK_HASHES=y
BR2_LINUX_KERNEL=y
BR2_LINUX_KERNEL_CUSTOM_TARBALL=y
BR2_LINUX_KERNEL_CUSTOM_TARBALL_LOCATION="$(call github,raspberrypi,linux,21b410140c47ffab5668399f6f143c7d7b935c8b)/linux-21b410140c47ffab5668399f6f143c7d7b935c8b.tar.gz"
BR2_LINUX_KERNEL_USE_CUSTOM_CONFIG=y
BR2_LINUX_KERNEL_CUSTOM_CONFIG_FILE="$(BR2_EXTERNAL_FASTLINUX_PATH)/board/fastlinux/base.config"
BR2_LINUX_KERNEL_DTS_SUPPORT=y
BR2_LINUX_KERNEL_INTREE_DTS_NAME="broadcom/bcm2710-rpi-zero-2-w"
BR2_LINUX_KERNEL_NEEDS_HOST_OPENSSL=y
BR2_PACKAGE_BUSYBOX_SHOW_OTHERS=y
BR2_PACKAGE_XZ=y
BR2_PACKAGE_RPI_FIRMWARE=y
BR2_PACKAGE_RPI_FIRMWARE_BOOTCODE_BIN=y
BR2_PACKAGE_RPI_FIRMWARE_VARIANT_PI=y
BR2_PACKAGE_KMOD=y
BR2_PACKAGE_KMOD_TOOLS=y
BR2_TARGET_ROOTFS_EXT2=y
BR2_TARGET_ROOTFS_EXT2_4=y
# BR2_TARGET_ROOTFS_TAR is not set
BR2_PACKAGE_HOST_DOSFSTOOLS=y
BR2_PACKAGE_HOST_GENIMAGE=y
BR2_PACKAGE_HOST_KMOD_XZ=y
BR2_PACKAGE_HOST_MTOOLS=y
BR2_cortex_a53=y
BR2_OPTIMIZE_S=y
BR2_TARGET_GENERIC_HOSTNAME="ninjalinux"
BR2_TARGET_GENERIC_ISSUE="ninjaLinux Zero 2 W PREEMPT_RT"
BR2_INIT_BUSYBOX=y
# BR2_TARGET_GENERIC_GETTY is not set
BR2_ROOTFS_DEVICE_CREATION_DYNAMIC_EUDEV=y
BR2_ROOTFS_OVERLAY="$(BR2_EXTERNAL_FASTLINUX_PATH)/board/fastlinux/rootfs-overlay"
BR2_ROOTFS_POST_BUILD_SCRIPT="$(BR2_EXTERNAL_FASTLINUX_PATH)/board/fastlinux/post-build.sh"
BR2_ROOTFS_POST_IMAGE_SCRIPT="$(BR2_EXTERNAL_FASTLINUX_PATH)/board/fastlinux/post-image.sh"
BR2_PACKAGE_RPI_FIRMWARE_CONFIG_FILE="$(BR2_EXTERNAL_FASTLINUX_PATH)/board/fastlinux/config.txt"
BR2_PACKAGE_RPI_FIRMWARE_INSTALL_DTB_OVERLAYS=y
BR2_PACKAGE_MESA3D=y
BR2_PACKAGE_MESA3D_GALLIUM_DRIVER_VC4=y
BR2_PACKAGE_MESA3D_OPENGL_EGL=y
BR2_PACKAGE_MESA3D_OPENGL_ES=y
BR2_PACKAGE_LIBDRM_INSTALL_TESTS=y
BR2_PACKAGE_LIBINPUT=y
BR2_PACKAGE_LIBINPUT_TOOLS=y
BR2_PACKAGE_QT6=y
BR2_PACKAGE_QT6BASE_GUI=y
BR2_PACKAGE_QT6BASE_WIDGETS=y
BR2_PACKAGE_QT6BASE_EGLFS=y
BR2_PACKAGE_QT6BASE_DEFAULT_QPA="eglfs"
BR2_PACKAGE_QT6BASE_OPENGL_ES2=y
BR2_PACKAGE_QT6BASE_NETWORK=y
BR2_PACKAGE_QT6BASE_PNG=y
BR2_PACKAGE_DEJAVU=y
BR2_PACKAGE_DEJAVU_SANS=y
BR2_PACKAGE_FASTLINUX_DEMO=y
BR2_PACKAGE_RT_TESTS=y
BR2_PACKAGE_IPERF3=y
BR2_PACKAGE_ETHTOOL=y
BR2_PACKAGE_UTIL_LINUX=y
BR2_PACKAGE_UTIL_LINUX_SCHEDUTILS=y
BR2_PACKAGE_DROPBEAR=y
BR2_TARGET_ROOTFS_EXT2_SIZE="512M"
BR2_TARGET_ROOTFS_EXT2_LABEL="FASTROOT"
BR2_TARGET_ROOTFS_EXT2_MKFS_OPTIONS="-O ^metadata_csum_seed,^orphan_file"
BR2_LINUX_KERNEL_CONFIG_FRAGMENT_FILES="$(BR2_EXTERNAL_FASTLINUX_PATH)/board/fastlinux/common.fragment $(BR2_EXTERNAL_FASTLINUX_PATH)/board/fastlinux/rt.fragment $(BR2_EXTERNAL_FASTLINUX_PATH)/board/fastlinux/wifi.fragment"
BR2_PACKAGE_PYTHON3=y
BR2_PACKAGE_PYTHON3_PY_PYC=y
BR2_PACKAGE_PYTHON3_READLINE=y
BR2_PACKAGE_PYTHON3_ZLIB=y
BR2_PACKAGE_PYTHON_PYSIDE6=y

BR2_PACKAGE_AUTOMATION_HAL=y

# Optional on-board Wi-Fi. No Bluetooth, desktop or network manager.
BR2_PACKAGE_BRCMFMAC_SDIO_FIRMWARE_RPI=y
BR2_PACKAGE_BRCMFMAC_SDIO_FIRMWARE_RPI_WIFI=y
BR2_PACKAGE_WIRELESS_REGDB=y
BR2_PACKAGE_IW=y
BR2_PACKAGE_IPROUTE2=y

# Dedicated local AP, without routing/NAT/bridging.
BR2_PACKAGE_HOSTAPD=y
BR2_PACKAGE_HOSTAPD_DRIVER_NL80211=y
# BR2_PACKAGE_HOSTAPD_ACS is not set
# BR2_PACKAGE_HOSTAPD_VLAN is not set
BR2_PACKAGE_DNSMASQ=y
# BR2_PACKAGE_DNSMASQ_TFTP is not set
```

## package/automation-hal/Config.in
```kconfig
config BR2_PACKAGE_AUTOMATION_HAL
 bool "Standalone Automation HAL"
 depends on BR2_PACKAGE_PYTHON3
 depends on BR2_PACKAGE_EUDEV
 help
   Private LinuxCNC-derived HAL runtime and Python binding.
   No motion hardware driver or automatic HAL startup is enabled.
```

## package/fastlinux-demo/Config.in
```kconfig
config BR2_PACKAGE_FASTLINUX_DEMO
 bool "FastLinux native GPU/touch demo"
 depends on BR2_PACKAGE_QT6BASE_GUI && BR2_PACKAGE_QT6BASE_OPENGL
```

## package/ninjalinux-file-explorer/Config.in
```kconfig
config BR2_PACKAGE_NINJALINUX_FILE_EXPLORER
	bool "ninjaLinux on-demand web file explorer"
	depends on BR2_PACKAGE_PYTHON3 && BR2_PACKAGE_BUSYBOX
	help
	  Local-network browser file management for /data. BusyBox inetd starts
	  Python only on incoming connections; it exits after an idle timeout.
	  Requires per-device configuration and an access token to enable.
```

## package/ninjalinux-usb-autostart/Config.in
```kconfig
config BR2_PACKAGE_NINJALINUX_USB_AUTOSTART
	bool "ninjaLinux boot-time USB application override"
	depends on BR2_PACKAGE_PYTHON3
	help
	  Scan USB storage once at boot for autostart.json. Keep root unchanged.
	  scripts/build.sh adds the required built-in storage fragment.
```

## package/python-pyside6/Config.in
```kconfig
config BR2_PACKAGE_PYTHON_PYSIDE6
 bool "PySide6 runtime for the appliance Qt build"
 depends on BR2_PACKAGE_PYTHON3
 depends on BR2_PACKAGE_QT6BASE_GUI && BR2_PACKAGE_QT6BASE_WIDGETS
 depends on BR2_PACKAGE_QT6BASE_OPENGL && BR2_PACKAGE_QT6BASE_NETWORK
 select BR2_PACKAGE_PYTHON_SHIBOKEN6
config BR2_PACKAGE_PYTHON_SHIBOKEN6
 bool
```
